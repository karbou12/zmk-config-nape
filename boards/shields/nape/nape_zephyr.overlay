#include "nape_common.overlay"

&trackball {
    status = "okay";
    compatible = "pixart,pmw3610";
    reg = <0>;
    spi-max-frequency = <2000000>;
    motion-gpios = <&xiao_d 0 (GPIO_ACTIVE_LOW | GPIO_PULL_UP)>;

    res-cpi = <800>;

    zephyr,axis-x = <INPUT_REL_X>;
    zephyr,axis-y = <INPUT_REL_Y>;

    smart-mode;
    force-awake;
};

