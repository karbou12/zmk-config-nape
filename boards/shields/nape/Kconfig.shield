## boards/shields/nape/Kconfig.shield
```kconfig
config NAPE
    def_bool $(shields_list_contains,nape)

config NAPE_CONSOLE
    def_bool $(shields_list_contains,nape_console)
    select NAPE
```

## config/west.yml
```yaml
manifest:
  remotes:
    - name: zmkfirmware
      url-base: https://github.com/zmkfirmware
    - name: menbou0202
      url-base: https://github.com/menbou0202
    - name: caksoylar
      url-base: https://github.com/caksoylar
    - name: karbou12
      url-base: https://github.com/karbou12
    # Additional modules containing boards/shields/custom code can be listed here as well
    # See https://docs.zephyrproject.org/3.2.0/develop/west/manifest.html#projects
  projects:
    - name: zmk
      remote: menbou0202
      revision: b3544e343c28580a2f5e68c23e83d6f175b8595f
      import: app/west.yml
    - name: zmk-pmw3610-driver-nape
      remote: karbou12
      revision: console/feature/trackball-shift
      import: true
    - name: zmk-rgbled-widget
      remote: karbou12
      revision: feature/color-indication-api
  self:
    path: config
```

## config_dya_studio/west.yml
```yaml
manifest:
  remotes:
    - name: zmkfirmware
      url-base: https://github.com/zmkfirmware
    - name: menbou0202
      url-base: https://github.com/menbou0202
    - name: caksoylar
      url-base: https://github.com/caksoylar
    - name: karbou12
      url-base: https://github.com/karbou12
    - name: cormoran
      url-base: https://github.com/cormoran
    # Additional modules containing boards/shields/custom code can be listed here as well
    # See https://docs.zephyrproject.org/3.2.0/develop/west/manifest.html#projects
  projects:
    - name: zmk
      remote: cormoran
      revision: main+dya
      clone-depth: 1
      import:
        file: app/west.yml
    - name: zephyr
      remote: cormoran
      revision: v4.1.0+zmk-fixes+nrf-half-duplex-uart
      clone-depth: 1
      import:
        name-blocklist:
          - ci-tools
          - hal_altera
          - hal_cypress
          - hal_infineon
          - hal_microchip
          - hal_nxp
          - hal_openisa
          - hal_xtensa
          - hal_st
          - hal_ti
          - loramac-node
          - mcuboot
          - mcumgr
          - net-tools
          - openthread
          - edtt
          - trusted-firmware-m
    - name: zmk-feature-custom-settings
      remote: cormoran
      revision: main
      groups: [dev]
    - name: zmk-feature-fast-keymap
      remote: cormoran
      revision: main
      groups: [dev]
    - name: zmk-rgbled-widget
      remote: karbou12
      revision: feature/color-indication-api
      groups: [dev]
    - name: zmk-trackball-shift
      remote: karbou12
      revision: main
      groups: [dev]
  self:
    path: config
```
